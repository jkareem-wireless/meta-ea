## conf/machine/imx6sxea-com.conf
```bitbake
#@TYPE: Machine
#@NAME: Embedded Artists i.MX6 SoloX COM Board
#@SOC: i.MX6SX
#@DESCRIPTION: Machine configuration for Embedded Artists i.MX6 SoloX COM Board
#@MAINTAINER: EA <imx@EmbeddedArtists.com>

require conf/machine/include/imx-base.inc
include conf/machine/include/arm/armv7a/tune-cortexa9.inc

SERIAL_CONSOLES = "115200;ttymxc0"

MACHINE_FEATURES += " pci wifi bluetooth nxp8987 mrvl8997"

MACHINEOVERRIDES =. "mx6:mx6sx:"

PREFERRED_PROVIDER_virtual/kernel:imx-nxp-bsp = "linux-ea"
PREFERRED_PROVIDER_virtual/kernel = "linux-ea"
PREFERRED_RPROVIDER_kernel-module-imx-gpu-viv = "linux-ea"

PREFERRED_PROVIDER_linux-mfgtool = "linux-ea-mfgtool"

KERNEL_DEVICETREE = "nxp/imx/imx6sxea-com-kit_v2.dtb \
  nxp/imx/imx6sxea-com-kit_v2-m4.dtb \
  nxp/imx/imx6sxea-com-kit_v2-ov5640-pl.dtb \
  nxp/imx/imx6sxea-com-kit_v2-pcie.dtb \
  nxp/imx/imx6sxea-com-ptp.dtb \
"

PREFERRED_PROVIDER_u-boot = "u-boot-ea"
PREFERRED_PROVIDER_virtual/bootloader:imx-nxp-bsp = "u-boot-ea"

PREFERRED_PROVIDER_u-boot-mfgtool = "u-boot-ea-mfgtool"
PREFERRED_PROVIDER_u-boot-fw-utils = "u-boot-ea-fw-utils"

UBOOT_CONFIG ??= "sd"
UBOOT_CONFIG[sd] = "mx6sxea-com_config"
UBOOT_CONFIG[mfgtool] = "mx6sxea-com-ptp_config"

UBOOT_MAKE_TARGET = "${@bb.utils.contains("UBOOT_CONFIG", "mfgtool", "u-boot.imx", "all",d)}"
UBOOT_SUFFIX = "${@bb.utils.contains("UBOOT_CONFIG", "mfgtool", "imx", "img",d)}"
SPL_BINARY = "${@bb.utils.contains("UBOOT_CONFIG", "mfgtool", "", "SPL",d)}"

WKS_FILE_DEPENDS += " \
        u-boot-script-ea \
        e2fsprogs-native \
        bmaptool-native \
"
WKS_FILE = "imx-uboot-spl-bootpart.wks.in"
```

## conf/machine/imx7dea-ucom.conf
```bitbake
#@TYPE: Machine
#@NAME: Embedded Artists i.MX7 Dual uCOM Board
#@SOC: i.MX7D
#@DESCRIPTION: Machine configuration for Embedded Artists i.MX7 Dual uCOM Board
#@MAINTAINER: EA <imx@EmbeddedArtists.com>

MACHINEOVERRIDES =. "mx7:mx7d:"

require conf/machine/include/imx-base.inc
require conf/machine/include/arm/armv7a/tune-cortexa7.inc

SERIAL_CONSOLES = "115200;ttymxc0"

MACHINE_FEATURES += " pci wifi bluetooth nxp8987 mrvl8997"


PREFERRED_PROVIDER_virtual/kernel:imx-nxp-bsp = "linux-ea"
PREFERRED_PROVIDER_virtual/kernel = "linux-ea"
PREFERRED_RPROVIDER_kernel-module-imx-gpu-viv = "linux-ea"

PREFERRED_PROVIDER_linux-mfgtool = "linux-ea-mfgtool"

KERNEL_DEVICETREE = "nxp/imx/imx7dea-ucom-kit_v2.dtb \
  nxp/imx/imx7dea-ucom-kit_v2-m4.dtb \
  nxp/imx/imx7dea-ucom-kit_v2-ov5640.dtb \
  nxp/imx/imx7dea-ucom-kit_v2-pcie.dtb \
  nxp/imx/imx7dea-ucom-ptp.dtb \
"

PREFERRED_PROVIDER_u-boot = "u-boot-ea"
PREFERRED_PROVIDER_virtual/bootloader:imx-nxp-bsp = "u-boot-ea"

PREFERRED_PROVIDER_u-boot-mfgtool = "u-boot-ea-mfgtool"
PREFERRED_PROVIDER_u-boot-fw-utils = "u-boot-ea-fw-utils"

UBOOT_CONFIG ??= "sd"
UBOOT_CONFIG[sd] = "mx7dea-ucom_config"
UBOOT_CONFIG[mfgtool] = "mx7dea-ucom-ptp_config"

UBOOT_MAKE_TARGET = "${@bb.utils.contains("UBOOT_CONFIG", "mfgtool", "u-boot.imx", "all",d)}"
UBOOT_SUFFIX = "${@bb.utils.contains("UBOOT_CONFIG", "mfgtool", "imx", "img",d)}"
SPL_BINARY = "${@bb.utils.contains("UBOOT_CONFIG", "mfgtool", "", "SPL",d)}"

WKS_FILE_DEPENDS += " \
        u-boot-script-ea \
        e2fsprogs-native \
        bmaptool-native \
"
WKS_FILE = "imx-uboot-spl-bootpart.wks.in"
```
